## config/boards/shields/tiboard/Kconfig.shield
```kconfig
# Copyright (c) 2020 Ryan Cross
# SPDX-License-Identifier: MIT

config SHIELD_TIBOARD_LEFT
	def_bool $(shields_list_contains,tiboard_left)

config SHIELD_TIBOARD_RIGHT
	def_bool $(shields_list_contains,tiboard_right)
```

## config/west.yml
```yaml
manifest:
  remotes:
    - name: zmkfirmware
      url-base: https://github.com/zmkfirmware
  projects:
    - name: zmk
      remote: zmkfirmware
      revision: feature/sofle_rgb_keyhive
      import: app/west.yml
  self:
    path: config
```
